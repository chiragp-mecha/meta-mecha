## conf/distro/mechanix.conf
```bitbake
# Mecha DISTRO with xwayland 

include conf/distro/include/fsl-imx-base.inc
include conf/distro/include/fsl-imx-preferred-env.inc
include conf/distro/include/cve-extra-exclusions.inc
require conf/distro/include/security_flags.inc

DISTRO = "mechanix"
DISTRO_NAME = "Mechanix"
DISTROOVERRIDES = "Mechanix"
DISTRO_VERSION = "24.03"
DISTRO_MINOR_VERSION = ".0"
DISTRO_CODENAME = "Apollo"

# Remove conflicting backends
DISTRO_FEATURES:remove = " directfb vulkan"
DISTRO_FEATURES:append = " opengl x11 wayland xwayland pam systemd polkit"

# Make var/log/* data persistent 
# [It will store kernel log data from the boards first boot, to non-volatile memory] 
VOLATILE_LOG_DIR = "no"
```
